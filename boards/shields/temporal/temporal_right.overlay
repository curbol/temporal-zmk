/*
 * Copyright (c) 2024 Curtis Bollinger
 *
 * SPDX-License-Identifier: MIT
 */

#include "temporal.dtsi"

&default_transform {
    col-offset = <6>;
};

&kscan0 {
    col-gpios
        = <&pro_micro 14 GPIO_ACTIVE_HIGH>  // col_inner
        , <&pro_micro 15 GPIO_ACTIVE_HIGH>  // col_index
        , <&pro_micro 18 GPIO_ACTIVE_HIGH>  // col_middle
        , <&pro_micro 19 GPIO_ACTIVE_HIGH>  // col_ring
        , <&pro_micro 20 GPIO_ACTIVE_HIGH>  // col_pinky (also encoder switch)
        , <&pro_micro 21 GPIO_ACTIVE_HIGH>  // col_extra
        ;
};

&right_encoder {
    status = "okay";
};

&sensors {
    sensors = <&right_encoder>;
};
