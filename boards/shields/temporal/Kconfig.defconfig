## boards/shields/temporal/Kconfig.defconfig
```kconfig
# Copyright (c) 2024 Curtis Bollinger
# SPDX-License-Identifier: MIT

if SHIELD_TEMPORAL_LEFT

config ZMK_KEYBOARD_NAME
    default "Temporal"

config ZMK_SPLIT_ROLE_CENTRAL
    default y

endif

if SHIELD_TEMPORAL_LEFT || SHIELD_TEMPORAL_RIGHT

config ZMK_SPLIT
    default y

endif
```

## boards/shields/temporal/Kconfig.shield
```kconfig
# Copyright (c) 2024 Curtis Bollinger
# SPDX-License-Identifier: MIT

config SHIELD_TEMPORAL_LEFT
    def_bool $(shields_list_contains,temporal_left)

config SHIELD_TEMPORAL_RIGHT
    def_bool $(shields_list_contains,temporal_right)
```
